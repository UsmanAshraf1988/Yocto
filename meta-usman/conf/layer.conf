## meta-usman/conf/layer.conf
```bitbake
# We have a conf and classes directory, add to BBPATH
BBPATH .= ":${LAYERDIR}"

# We have recipes-* directories, add to BBFILES
BBFILES += "${LAYERDIR}/recipes-*/*/*.bb \
            ${LAYERDIR}/recipes-*/*/*.bbappend"

BBFILE_COLLECTIONS += "meta-usman"
BBFILE_PATTERN_meta-usman = "^${LAYERDIR}/"
BBFILE_PRIORITY_meta-usman = "6"

LAYERDEPENDS_meta-usman = "core"
LAYERSERIES_COMPAT_meta-usman = "kirkstone"
```
